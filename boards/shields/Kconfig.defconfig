## boards/shields/Kconfig.defconfig
```kconfig
if SHIELD_URCHIN_DONGLE

config ZMK_KEYBOARD_NAME
    default "Urchin"

config ZMK_SPLIT_ROLE_CENTRAL
    default y

config ZMK_USB
    default y

endif

if SHIELD_URCHIN_LEFT || SHIELD_URCHIN_RIGHT || SHIELD_URCHIN_DONGLE

config ZMK_SPLIT
    default y

config ZMK_BLE
    default y

endif
```

## boards/shields/urchin_dongle/Kconfig.defconfig
```kconfig
if SHIELD_URCHIN_DONGLE

config ZMK_KEYBOARD_NAME
    default "Urchin"

config ZMK_SPLIT_ROLE_CENTRAL
    default y

config ZMK_USB
    default y

endif

if SHIELD_URCHIN_LEFT || SHIELD_URCHIN_RIGHT || SHIELD_URCHIN_DONGLE

config ZMK_SPLIT
    default y

config ZMK_BLE
    default y

endif

if SHIELD_URCHIN_DONGLE

config BOARD_XIAO_BLE
    bool "XIAO BLE Board Detection"
    default y if BOARD_XIAO_BLE || BOARD_SEEEDUINO_XIAO_BLE
    default n
    help
      This option is automatically enabled when building with the
      Seeed XIAO BLE board. It is used to conditionally exclude
      certain hardware configurations (like LEDs) that are not
      compatible with the XIAO BLE.

endif 
```

## boards/shields/urchin_dongle/Kconfig.shield
```kconfig
config SHIELD_URCHIN_LEFT
    def_bool $(shields_list_contains,urchin_left)

config SHIELD_URCHIN_RIGHT
    def_bool $(shields_list_contains,urchin_right)

config SHIELD_URCHIN_DONGLE
    def_bool $(shields_list_contains,urchin_dongle)
```

## boards/shields/urchin_dongle/boards/nice_nano.conf
```kconfig
# Enable poor-mans-led-indicator for nice_nano
CONFIG_INDICATOR_LED_WIDGET=y
CONFIG_INDICATOR_LED_SHOW_LAYER_CHANGE=y
CONFIG_INDICATOR_LED_LAYER_PERSISTENCE_THRESHOLD=1
```

## boards/shields/xiao_dongle/Kconfig.defconfig
```kconfig
if SHIELD_XIAO_DONGLE

config ZMK_KEYBOARD_NAME
    default "Urchin"

config ZMK_SPLIT_ROLE_CENTRAL
    default y

config ZMK_USB
    default y

endif

if SHIELD_XIAO_LEFT || SHIELD_XIAO_RIGHT || SHIELD_XIAO_DONGLE

config ZMK_SPLIT
    default y

config ZMK_BLE
    default y

endif
```

## config/west.yml
```yaml
manifest:
  remotes:
    # zmk official
    - name: zmkfirmware
      url-base: https://github.com/zmkfirmware
    # zmk with battery upower 
    # - name: zmkfirmware
    #   url-base: https://github.com/eyesonly
      # bravekarma
    - name: caksoylar
      url-base: https://github.com/caksoylar
      # kyek / duckyb
    - name: duckyb
      url-base: https://github.com/duckyb
      # nice-view-gem
    - name: m165437
      url-base: https://github.com/M165437
    - name: badjeff
      url-base: https://github.com/badjeff
    - name: urob
      url-base: https://github.com/urob
    - name: eyesonly
      url-base: https://github.com/eyesonly
  projects:
    - name: zmk
      remote: zmkfirmware
      revision: main
      import: app/west.yml
    - name: urchin-zmk-module
      remote: duckyb
      revision: main
    - name: nice-view-gem
      remote: m165437
      revision: main
    - name: zmk-rgbled-widget
      remote: caksoylar
      revision: main
    - name: zmk-behavior-battery-percentage-printer
      remote: badjeff
      revision: main
    - name: zmk-adaptive-key
      remote: urob
      revision: main # set to same as ZMK version above      
    # - name: zmk-poor-mans-led-indicator
    #   remote: eyesonly
    #   revision: main
self:
    path: config
```
